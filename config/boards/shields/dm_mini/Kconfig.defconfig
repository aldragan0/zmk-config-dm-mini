## config/boards/shields/dm_mini/Kconfig.defconfig
```kconfig
if SHIELD_DM_MINI_LEFT

config ZMK_KEYBOARD_NAME
    default "Dactyl Mini 4x6"

config ZMK_SPLIT_ROLE_CENTRAL
    default y

endif


if SHIELD_DM_MINI_LEFT || SHIELD_DM_MINI_RIGHT

config ZMK_SPLIT
    default y

endif
```

## config/boards/shields/dm_mini/Kconfig.shield
```kconfig
config SHIELD_DM_MINI_LEFT
  def_bool $(shields_list_contains,dm_mini_left)

config SHIELD_DM_MINI_RIGHT
  def_bool $(shields_list_contains,dm_mini_right)
```

## config/boards/shields/dm_mini_4x6/Kconfig.defconfig
```kconfig
if SHIELD_DM_MINI_4X6_LEFT

    config ZMK_KEYBOARD_NAME
        default "Dactyl Mini 4x6(Left)"

    config ZMK_SPLIT_BLE_ROLE_CENTRAL
        default y

endif

if SHIELD_DM_MINI_4X6_RIGHT

    config ZMK_KEYBOARD_NAME
        default "Dactyl Mini 4x6(Right)"

endif

if SHIELD_DM_MINI_4X6_LEFT || SHIELD_DM_MINI_4X6_RIGHT

    config ZMK_SPLIT
        default y

endif
```

## config/boards/shields/dm_mini_4x6/Kconfig.shield
```kconfig
config SHIELD_DM_MINI_4X6_LEFT
  def_bool $(shields_list_contains, dm_mini_4x6_left)

config SHIELD_DM_MINI_4X6_RIGHT
  def_bool $(shields_list_contains, dm_mini_4x6_right)
```
